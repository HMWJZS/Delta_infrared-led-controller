## firmware/esp32s3_led/sdkconfig.defaults
```kconfig
# ESP-IDF 工程默认配置
CONFIG_IDF_TARGET="esp32s3"
CONFIG_FREERTOS_HZ=1000
CONFIG_ESP_MAIN_TASK_STACK_SIZE=8192
CONFIG_LWIP_SO_REUSE=y

# 模组实为 ESP32-S3-WROOM-1-N16R8：16MB Flash + 8MB 八线 PSRAM
# （本项目不用 PSRAM，保持默认关闭；八线 PSRAM 会占用 IO35~37）
CONFIG_ESPTOOLPY_FLASHSIZE_16MB=y

# 使用工程根目录下的自定义分区表（含 ota_0/ota_1 双 app 分区）
CONFIG_PARTITION_TABLE_CUSTOM=y
CONFIG_PARTITION_TABLE_CUSTOM_FILENAME="partitions.csv"
```
